## l3/l3_e1/sample.yaml
```yaml
sample:
  description: Matter Fundamentals Course  
  name: Matter Fundamentals Course - Lesson 3 Exercise 1 

common: 
    sysbuild: true
    build_only: true
    skip: true

    integration_platforms:
      - nrf54l15dk/nrf54l15/cpuapp
      - nrf54lm20dk/nrf54lm20a/cpuapp
    platform_allow:
      - nrf54l15dk/nrf54l15/cpuapp
      - nrf54lm20dk/nrf54lm20a/cpuapp

tests:
  l3.e1: {} 
  
```

## l4/l4_e1_sol/Kconfig
```kconfig
#
# Copyright (c) 2022 Nordic Semiconductor
#
# SPDX-License-Identifier: LicenseRef-Nordic-5-Clause
#
mainmenu "Mattfund Lesson 4 Exercise 1"

config CHIP_WIFI
	default y if BOARD_NRF7002DK_NRF5340_CPUAPP || SHIELD_NRF7002EB2
	select DEPRECATED if SOC_SERIES_NRF53X

source "$(ZEPHYR_CONNECTEDHOMEIP_MODULE_DIR)/config/nrfconnect/chip-module/Kconfig.features"
source "$(ZEPHYR_CONNECTEDHOMEIP_MODULE_DIR)/config/nrfconnect/chip-module/Kconfig.defaults"
source "$(ZEPHYR_NRF_MODULE_DIR)/samples/matter/common/src/Kconfig"
source "Kconfig.zephyr"
```

## l5/l5_e1_sol/sample.yaml
```yaml
sample:
  description: Matter Fundamentals Course  
  name: Matter Fundamentals Course - Lesson 5 Exercise 1 

common: 
    sysbuild: true
    build_only: true

    integration_platforms:
      - nrf54l15dk/nrf54l15/cpuapp
      - nrf54lm20dk/nrf54lm20a/cpuapp
    platform_allow:
      - nrf54l15dk/nrf54l15/cpuapp
      - nrf54lm20dk/nrf54lm20a/cpuapp

tests:
  l5.e1.sol: {} 
```
